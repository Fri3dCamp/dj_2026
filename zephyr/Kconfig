## zephyr/Kconfig
```kconfig
# Copyright (c) 2026 Bert Outtier <outtierbert@gmail.com>
# SPDX-License-Identifier: Apache-2.0

rsource "drivers/Kconfig"
```

## zephyr/drivers/Kconfig
```kconfig
# Copyright (c) 2026 Bert Outtier <outtierbert@gmail.com>
# SPDX-License-Identifier: Apache-2.0

rsource "mfd/Kconfig"
rsource "input/Kconfig"
rsource "led_strip/Kconfig"
```

## zephyr/drivers/input/Kconfig
```kconfig
# Copyright (c) 2026 Bert Outtier <outtierbert@gmail.com>
# SPDX-License-Identifier: Apache-2.0

if INPUT

config INPUT_FRI3D_DJ_ADDON
	bool "Fri3d Camp 2026 DJ add-on controls"
	default y
	depends on DT_HAS_FRI3D_DJ_ADDON_INPUT_ENABLED
	depends on MULTITHREADING # the MFD uses work items
	select MFD
	help
	  Buttons, potmeters, faders and encoders of the Fri3d Camp 2026 DJ
	  add-on.

config INPUT_FRI3D_DJ_ADDON_INIT_PRIORITY
	int "Initialization priority"
	default INPUT_INIT_PRIORITY
	depends on INPUT_FRI3D_DJ_ADDON

endif # INPUT
```

## zephyr/drivers/led_strip/Kconfig
```kconfig
# Copyright (c) 2026 Bert Outtier <outtierbert@gmail.com>
# SPDX-License-Identifier: Apache-2.0

if LED_STRIP

config LED_STRIP_FRI3D_DJ_ADDON
	bool "Fri3d Camp 2026 DJ add-on button LEDs"
	default y
	depends on DT_HAS_FRI3D_DJ_ADDON_LED_STRIP_ENABLED
	depends on MULTITHREADING # the MFD uses work items
	select MFD
	help
	  The 8 RGB button LEDs of the Fri3d Camp 2026 DJ add-on, as an LED
	  strip.

config LED_STRIP_FRI3D_DJ_ADDON_INIT_PRIORITY
	int "Initialization priority"
	default LED_STRIP_INIT_PRIORITY
	depends on LED_STRIP_FRI3D_DJ_ADDON

endif # LED_STRIP
```

## zephyr/drivers/mfd/Kconfig
```kconfig
# Copyright (c) 2026 Bert Outtier <outtierbert@gmail.com>
# SPDX-License-Identifier: Apache-2.0

if MFD

config MFD_FRI3D_DJ_ADDON
	bool "Fri3d Camp 2026 DJ add-on"
	default y
	depends on DT_HAS_FRI3D_DJ_ADDON_ENABLED
	depends on MULTITHREADING # the MFD uses work items
	depends on SERIAL # the add-on's UART output triggers the reads
	select I2C
	select UART_INTERRUPT_DRIVEN
	help
	  Multi-function device driver for the CH32X035 of the Fri3d Camp
	  2026 DJ add-on on the expansion connector.

config MFD_FRI3D_DJ_ADDON_INIT_PRIORITY
	int "DJ add-on initialization priority"
	default MFD_INIT_PRIORITY
	depends on MFD_FRI3D_DJ_ADDON
	help
	  Must be after the I2C controller and GPIO drivers.

config MFD_FRI3D_DJ_ADDON_SHELL
	bool "DJ add-on shell commands"
	default y
	depends on MFD_FRI3D_DJ_ADDON && SHELL
	help
	  The "djaddon" shell command: firmware version, and with a bundled
	  image (MFD_FRI3D_DJ_ADDON_FIRMWARE) its installation.

config MFD_FRI3D_DJ_ADDON_UPDATE
	bool "DJ add-on firmware update over RVSWD"
	depends on MFD_FRI3D_DJ_ADDON
	help
	  Update the add-on firmware with mfd_fri3d_dj_addon_update(), through
	  the RVSWD interface of the add-on's rvswd property: the firmware
	  gives its I2C pins to SWD on request (remap). Needs the
	  zephyr-rvswd module (github.com/bertouttier/zephyr-rvswd) in the
	  west workspace and an enabled wch,rvswd node as the add-on's rvswd
	  property (<fri3d/dj_addon.dtsi> has it); the build stops if either is
	  missing.

if MFD_FRI3D_DJ_ADDON_UPDATE

config MFD_FRI3D_DJ_ADDON_FIRMWARE
	string "DJ add-on firmware image to bundle"
	help
	  Path to a DJ add-on firmware binary (dj_2026 release build), absolute
	  or relative to the application directory, to link into the
	  application. Empty: no image. With an image, the "djaddon update"
	  shell command installs it.

config MFD_FRI3D_DJ_ADDON_FIRMWARE_VERSION
	string "Version of the bundled firmware image"
	default "0.0.0"
	help
	  Version of the image in MFD_FRI3D_DJ_ADDON_FIRMWARE, as
	  major.minor.patch. Applications compare it with the add-on's version
	  (mfd_fri3d_dj_addon_get_bundled_version()) to decide on an update; it
	  must match the image.

endif # MFD_FRI3D_DJ_ADDON_UPDATE

endif # MFD
```

## zephyr/dts/bindings/input/fri3d,dj-addon-input.yaml
```yaml
# Copyright (c) 2026 Bert Outtier <outtierbert@gmail.com>
# SPDX-License-Identifier: Apache-2.0

description: |
  Controls of the Fri3d Camp 2026 DJ add-on, as input events: the buttons as
  INPUT_EV_KEY, the potmeters and faders as INPUT_EV_ABS (0-4095, 0 at the
  physical minimum) and the encoders as INPUT_EV_REL (steps since the last
  event).

compatible: "fri3d,dj-addon-input"

include: base.yaml

properties:
  button-codes:
    type: array
    required: true
    description: |
      Key codes of the 8 buttons, in the order of the button register bits
      (bit 0 first). The add-on firmware sends bit i as CC button_note[i]
      (64 66 65 60 62 61 67 63): CC 60-63 is the top row, 64-67 the bottom
      row, left to right.

  analog-codes:
    type: array
    required: true
    description: |
      Axis codes of the 9 analog channels, in register order: left
      potmeters bottom, middle, top, left fader, right potmeters bottom,
      middle, top, right fader, crossfader.

  encoder-codes:
    type: array
    required: true
    description: Axis codes of the left and right encoders.

  analog-dead-zone:
    type: int
    default: 0
    description: |
      Raw counts (12 bit) ignored at both ends of the analog range; the rest
      is scaled to the full 0-4095, so every potmeter and fader reaches both
      ends even if it does not reach the extreme ADC values.

  analog-threshold:
    type: int
    default: 16
    description: |
      Smallest change of an analog channel (12 bit) that is reported, to
      filter out ADC noise.
```

## zephyr/dts/bindings/led_strip/fri3d,dj-addon-led-strip.yaml
```yaml
# Copyright (c) 2026 Bert Outtier <outtierbert@gmail.com>
# SPDX-License-Identifier: Apache-2.0

description: |
  The 8 RGB button LEDs of the Fri3d Camp 2026 DJ add-on, as an LED strip
  (pixels in the order of the add-on LED registers).

compatible: "fri3d,dj-addon-led-strip"

include: base.yaml
```

## zephyr/dts/bindings/mfd/fri3d,dj-addon.yaml
```yaml
# Copyright (c) 2026 Bert Outtier <outtierbert@gmail.com>
# SPDX-License-Identifier: Apache-2.0

description: |
  DJ add-on of the Fri3d Camp 2026 badge on the expansion connector: a
  CH32X035 running the dj_2026 firmware as an I2C slave (address 0x3A) with
  8 buttons, 6 potmeters, 3 faders, 2 encoders and 8 RGB LEDs.

  The add-on firmware (a release build) sends MIDI on its UART on every input
  change: the driver reads the inputs over I2C when data arrives on the UART,
  it does not poll them. The node says the add-on is there: the driver waits
  boot-timeout-ms for it at init and fails without it (no hotplug). It needs add-on firmware v1.0.4 or later (consistent 16-bit
  registers). The functions are child nodes, see <fri3d/dj_addon.dtsi>:

    dj_addon: dj-addon@3a {
        compatible = "fri3d,dj-addon";
        reg = <0x3a>;
        uart = <&uart0>;

        dj_addon_input: input {
            compatible = "fri3d,dj-addon-input";
            button-codes = <...>;
            analog-codes = <...>;
            encoder-codes = <...>;
        };

        dj_addon_leds: leds {
            compatible = "fri3d,dj-addon-led-strip";
        };
    };

compatible: "fri3d,dj-addon"

include: i2c-device.yaml

properties:
  uart:
    type: phandle
    required: true
    description: |
      UART that receives the add-on's MIDI output (115200 baud, expansion
      connector pin 3, badge IO44). Data on it triggers a read of the inputs;
      the driver discards it and does not transmit.

  rvswd:
    type: phandle
    description: |
      RVSWD interface (wch,rvswd) on the add-on's I2C pins (the expansion I2C
      bus), to update its firmware (CONFIG_MFD_FRI3D_DJ_ADDON_UPDATE).

  poll-period-ms:
    type: int
    default: 10
    description: Minimum time between two reads of the inputs.

  boot-timeout-ms:
    type: int
    default: 1500
    description: |
      Time to wait for the add-on to answer on I2C at init. After a power-on
      its firmware waits one second before it enables its I2C slave.
```
